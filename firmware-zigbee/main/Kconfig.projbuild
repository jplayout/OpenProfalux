## firmware-zigbee/main/Kconfig.projbuild
```kconfig
menu "OpenProfalux Zigbee simulation"
    config OPF_RADIO_MODE
        int "Boot radio mode (0 simulation, 1 diagnostic, 2 future active/TX locked)"
        range 0 2
        default 0

    config OPF_RADIO_CONSOLE
        bool "Local USB radio diagnostic console"
        depends on OPF_ZB_USB_DIAGNOSTIC
        default n
        help
            Explicit local mode/learn/cancel commands. Learning expires after at most 60 s.

    config OPF_ZB_USB_DIAGNOSTIC
        bool "USB diagnostic mode (disable automatic light-sleep)"
        default n
        depends on ESP_CONSOLE_USB_SERIAL_JTAG
        help
            Keep the CPU awake for native USB logs. Not intended for battery measurements.

    config OPF_ZB_POLL_INTERVAL_MS
        int "SED keepalive/poll interval (ms)"
        range 1000 5000
        default 1000
        help
            Evaluate 1000, 2000 and 5000 ms against the real parent buffer timeout.
            This is not the child aging timeout or the fast poll interval.
endmenu
```

## firmware-zigbee/sdkconfig.defaults
```kconfig
CONFIG_ZB_ENABLED=y
CONFIG_ZB_ZED=y
CONFIG_ZB_RADIO_NATIVE=y
CONFIG_PM_ENABLE=y
CONFIG_FREERTOS_USE_TICKLESS_IDLE=y
CONFIG_ESPTOOLPY_FLASHSIZE_4MB=y
CONFIG_ESP_CONSOLE_UART_DEFAULT=y
CONFIG_ESP_CONSOLE_SECONDARY_NONE=y
```
